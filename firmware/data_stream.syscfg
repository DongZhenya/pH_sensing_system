/*
 * Copyright (c) 2018, Texas Instruments Incorporated
 * All rights reserved.
 */
// @cliArgs --board /ti/boards/LP_EM_CC2340R53 --rtos freertos

/*
 *  data_stream.syscfg
 */

/* ======== Example Configuration ======== */
const lpName = system.getScript("/ti/ble/ble_common.js").getLaunchPadName();
/* DIO20_A11 is Vsen_buf on the custom PCB, so it cannot be UART TX. */
var needsDisplay = false;
var needsButtons = true;
var needsLeds = true;
var needsNvs = true;
var needsOad = false;
var heapSize = 0x00004D50;
var timerStackSize = 0x00000190;
var idleStackSize = 0x00000130;

/* ======== BLE ======== */
var ble = scripting.addModule("/ti/ble/ble");
ble.deviceRole = "PERIPHERAL_CFG";
ble.basicBLE = true;
ble.disDevBySerUuid = true;
ble.maxConnNum = 1;
/* Continuous per-channel notifications need short connection events. */
ble.connUpdateParamsPeripheral.reqMinConnInt = 15;
ble.connUpdateParamsPeripheral.reqMaxConnInt = 30;
ble.connUpdateParamsPeripheral.reqPeripheralLat = 0;
ble.connUpdateParamsPeripheral.reqConnTo = 6000;
ble.deviceName = "Data Stream";
ble.numOfAdvSets = 1;
ble.bondPairing = "GAPBOND_PAIRING_MODE_WAIT_FOR_REQ";
ble.maxNumPrepareWrites = 10;
ble.hideHealthToolkit = false;
ble.disableDisplayModule = true;

// Gap Advertising Flags
ble.advSet1.advData1.GAP_ADTYPE_FLAGS = true;
ble.advSet1.advData1.advertisingFlags = ["GAP_ADTYPE_FLAGS_BREDR_NOT_SUPPORTED","GAP_ADTYPE_FLAGS_GENERAL"];
// 128-bit UUIDs
ble.advSet1.advData1.GAP_ADTYPE_128BIT_MORE = true;
ble.advSet1.advData1.numOfUUIDs128More = 1;
ble.advSet1.advData1.UUID0128More = system.utils.bigInt("00000000000000B000405104C0C000F0",16);
/* Prototype manufacturer data: CH, G, Vsen_mV low byte, Vsen_mV high byte.
 * 0xFFFF is a placeholder; use an assigned company ID before release. */
ble.advSet1.advData1.GAP_ADTYPE_MANUFACTURER_SPECIFIC = true;
ble.advSet1.advData1.companyIdentifier = 0xFFFF;
ble.advSet1.advData1.additionalData = "00000000";
// Complete local name
ble.advSet1.scanRes1.GAP_ADTYPE_LOCAL_NAME_COMPLETE = true;
const connIntervalRange = system.getScript("/ti/ble/ble_common.js").getPeripheralConnIntervalRange();
ble.advSet1.scanRes1[connIntervalRange] = true;
// Min Connection Interval
ble.advSet1.scanRes1.minConnInterval = 100;
// Max Connection Interval
ble.advSet1.scanRes1.maxConnInterval = 130;
// TX Power Level
ble.advSet1.scanRes1.GAP_ADTYPE_POWER_LEVEL = true;

/* ======== RCL ======== */
const RCL = scripting.addModule("/ti/drivers/RCL");
if (typeof rclPbeGpoMask !== 'undefined')
{
    RCL.pbeGpoMask = rclPbeGpoMask;
}
if (typeof rclUseCase !== 'undefined')
{
    RCL.useCase = rclUseCase;
}
if (typeof rclSignals !== 'undefined')
{
    RCL.signals = rclSignals;

    if (typeof pbegpo2Pin !== 'undefined' && typeof pbegpo3Pin !== 'undefined')
    {
        RCL.lrfGpio.pbegpo2Pin.$assign = pbegpo2Pin;
        RCL.lrfGpio.pbegpo3Pin.$assign = pbegpo3Pin;
        RCL.pbegpo2PinInstance.initialOutputState = "High";
    }
}

/* ======== POWER ======== */
var Power = scripting.addModule("/ti/drivers/Power");
if (typeof needsPowerWfi !== 'undefined' && needsPowerWfi)
{
    if (lpName.match(/CC27\d\d/))
    {
        Power.policyFunction = "PowerCC27XX_doWFI";
    }
    else if (lpName.match(/CC23\d\d/))
    {
        Power.policyFunction = "PowerCC23X0_doWFI";
    }
}

/* ======== RNG ======== */
var RNG = scripting.addModule("/ti/drivers/RNG");
RNG.rngReturnBehavior = "RNG_RETURN_BEHAVIOR_BLOCKING";

/* ======== RF Design ======== */
var rfDesign = scripting.addModule("ti/devices/radioconfig/rfdesign");
const rfDesignSettings = system.getScript("/ti/common/lprf_rf_design_settings.js").rfDesignSettings;
for(var setting in rfDesignSettings)
{
    rfDesign[setting] = rfDesignSettings[setting];
}

/* ======== Device ======== */
var device = scripting.addModule("ti/devices/CCFG");
const ccfgSettings = system.getScript("/ti/common/lprf_ccfg_settings.js").ccfgSettings;
for(var setting in ccfgSettings)
{
    device[setting] = ccfgSettings[setting];
}

/* ======== FreeRTOS ======== */
const FreeRTOS = scripting.addModule("/freertos/FreeRTOS");
const Settings = scripting.addModule("/ti/posix/freertos/Settings");
const bleCommon = system.getScript("/ti/ble/.meta/ble_common.js");

FreeRTOS.heapSize = heapSize;
FreeRTOS.maxPriorities = 10;

// configure Timer task priority = maxPriorities - 1 - same level as Stack priority
bleCommon.configureTimerTaskPriority(FreeRTOS); 

if (lpName.match(/CC27\d\d/))
{
    FreeRTOS.heapSize = 0x00010000;
}
if (lpName == "LP_EM_CC2340R53")
{
    FreeRTOS.heapSize = 0x0000A000;
}
FreeRTOS.timerStackSize = timerStackSize;
FreeRTOS.idleStackSize = idleStackSize;

/* ======== NVS ======== */
var NVS = scripting.addModule("/ti/drivers/NVS");
if (needsNvs)
{
    var nvs = NVS.addInstance();
    nvs.internalFlash.regionBase = system.getScript("/ti/ble/ble_common.js").getBondNVBaseAddress();
    nvs.internalFlash.regionSize = 0x3000;
    nvs.$name = "CONFIG_NVSINTERNAL";
}

/* ======== Display (conditional) ======== */
if (needsDisplay)
{
    var Display = scripting.addModule("/ti/display/Display");
    var displayUART = Display.addInstance();
    displayUART.$hardware = system.deviceData.board.components.XDS110UART;
    displayUART.enableANSI = true;
    displayUART.uartBufferSize = 128;
    displayUART.uart.txPinInstance.outputState = "High";
    displayUART.uart.$name = "CONFIG_UART2_0";
    displayUART.uart.txPinInstance.$name = "CONFIG_PIN_UART_TX";
}

/* Custom PCB: Vsen_buf -> YBG A3 / DIO20_A11 / ADC channel 11. */
var ADC = scripting.addModule("/ti/drivers/ADC");
var vsenAdc = ADC.addInstance();
vsenAdc.$name = "CONFIG_ADC_VSEN";
vsenAdc.adcChannel.referenceSource = "ADCLPF3_VDDS_REFERENCE";
vsenAdc.adcChannel.vddsVoltage = 3300000;
vsenAdc.adcChannel.adc.adcPin.$assign = "DIO20_A11";

/* ======== UART for NPI (conditional) ======== */
if (typeof needsUartNpi !== 'undefined' && needsUartNpi)
{
    var UART = scripting.addModule("/ti/drivers/UART2", {}, false);
    var UART1 = UART.addInstance();
    UART1.$hardware = system.deviceData.board.components.XDS110UART;
    UART1.txPinInstance.initialOutputState = "High";
    UART1.$name = "CONFIG_UART2_0";
    ble.disableDisplayModule = true;
}

/* ======== Buttons (conditional) ======== */
if (needsButtons)
{
    const Button = scripting.addModule("/ti/drivers/apps/Button", {}, false);
    const Button1 = Button.addInstance();
    const Button2 = Button.addInstance();
    Button1.$name = "CONFIG_BUTTON_0";
    Button1.$hardware = system.deviceData.board.components["BTN-1"];
    Button2.$name = "CONFIG_BUTTON_1";
    Button2.$hardware = system.deviceData.board.components["BTN-2"];
}

/* ======== LEDs (conditional) ======== */
if (needsLeds)
{
    const GPIO = scripting.addModule("/ti/drivers/GPIO");
    const GPIO2 = GPIO.addInstance();
    GPIO2.$hardware = system.deviceData.board.components.LED_GREEN;
    GPIO2.$name = "CONFIG_GPIO_LED_GREEN";
    const GPIO3 = GPIO.addInstance();
    GPIO3.$hardware = system.deviceData.board.components.LED_RED;
    GPIO3.$name = "CONFIG_GPIO_LED_RED";

    /* Custom CC2340R53 PCB control pins (YBG package ball names). */
    const GPIO_B3 = GPIO.addInstance();
    GPIO_B3.$name = "CONFIG_GPIO_B3_DIO18";
    GPIO_B3.mode = "Output";
    GPIO_B3.initialOutputState = "High";
    GPIO_B3.gpioPin.$assign = "DIO18";

    const GPIO_A4 = GPIO.addInstance();
    GPIO_A4.$name = "CONFIG_GPIO_A4_DIO21";
    GPIO_A4.mode = "Output";
    GPIO_A4.initialOutputState = "Low";
    GPIO_A4.gpioPin.$assign = "DIO21_A10";

    /* A2 is DIO17/SWDCK. Keep it untouched while GPIO_init() runs so an
     * active debugger does not lose the SWD clock pin. The application
     * configures it at run time only when no debugger is attached. */
    const GPIO_A2 = GPIO.addInstance();
    GPIO_A2.$name = "CONFIG_GPIO_A2_DIO17_SWDCK";
    GPIO_A2.doNotConfig = true;
    GPIO_A2.gpioPin.$assign = "DIO17_SWDCK";

    /* INA_GS0 is YBG A1 / SWDIO: leave it untouched during debugger use. */
    const GPIO_INA_GS0 = GPIO.addInstance();
    GPIO_INA_GS0.$name = "CONFIG_GPIO_INA_GS0_DIO16_SWDIO";
    GPIO_INA_GS0.doNotConfig = true;
    GPIO_INA_GS0.gpioPin.$assign = "DIO16_SWDIO";

    /* INA_GS1 is YBG C4 / DIO24_A7. */
    const GPIO_INA_GS1 = GPIO.addInstance();
    GPIO_INA_GS1.$name = "CONFIG_GPIO_INA_GS1_DIO24";
    GPIO_INA_GS1.mode = "Output";
    GPIO_INA_GS1.initialOutputState = "Low";
    GPIO_INA_GS1.gpioPin.$assign = "DIO24_A7";

    const GPIO_B1 = GPIO.addInstance();
    GPIO_B1.$name = "CONFIG_GPIO_B1_DIO11";
    GPIO_B1.mode = "Output";
    GPIO_B1.initialOutputState = "Low";
    GPIO_B1.gpioPin.$assign = "DIO11";

    const GPIO_B2 = GPIO.addInstance();
    GPIO_B2.$name = "CONFIG_GPIO_B2_DIO12";
    GPIO_B2.mode = "Output";
    GPIO_B2.initialOutputState = "Low";
    GPIO_B2.gpioPin.$assign = "DIO12";

    const GPIO_C2 = GPIO.addInstance();
    GPIO_C2.$name = "CONFIG_GPIO_C2_DIO8";
    GPIO_C2.mode = "Output";
    GPIO_C2.initialOutputState = "Low";
    GPIO_C2.gpioPin.$assign = "DIO8";
}

/* ======== OAD (CC23xx) ======== */
/* OAD needs to be added after Bond NVS so Bond NVS handle will remain '0' */
if(needsOad && !(lpName.match(/CC27\d\d/)))
{
    /* Persistent is enabled differently, as it is relevant only within the persistent example. */
    if (oadMethod == "OAD_APP_PERSISTENT")
    {
        ble.enableOad = true;
        ble.enablePersistentOad = true;
        ble.mcubootSignVersion1 = "0.0.1";
        ble.oadMethod = "NONE";
    }
    else if (oadMethod == "MULTISTEP_OAD")
    {
        /* For multistep-oad, we need to specifically inset the oadMethod as this string is used
           by the prebuild script in order to inject the halfModeBuild to the sysconfig file */
        ble.enableOad = true;
        ble.oadMethod = "MULTISTEP_OAD";
    }
    else
    {
        ble.enableOad = true;
        ble.oadMethod = oadMethod;
    }
}
